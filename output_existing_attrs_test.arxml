AUTOSAR XML (schema 4-2-1)
pdu SOUND_Short_eHorizon_Pdu: length=64, contained-i-pdu-props={collection-semantics=QUEUED, header-id-long-header=20519, trigger=ALWAYS}, transmission-mode-condition{data-filter=data-filter-type=ALWAYS, i-signal-in-i-pdu=isShort_eHorizonExt_mrx}, transmission-mode-true-timing=event-controlled-timing=number-of-repetitions=0, unused-bit-pattern=0
  mapping isShort_eHorizonExt_mrx: i-signal=isShort_eHorizonExt, packing-byte-order=opaque, start-position=0, transfer-property=TRIGGERED
